## conf/layer.conf
```bitbake
# Layer configuration for meta-useraccess

BBPATH .= ":${LAYERDIR}"
BBFILES += "${LAYERDIR}/recipes-*/*/*.bb \
            ${LAYERDIR}/recipes-*/*/*.bbappend"

#Host ssh-keygen required during build for key generation
HOSTTOOLS += "ssh-keygen"

BBFILE_COLLECTIONS += "useraccess"
BBFILE_PATTERN_useraccess := "^${LAYERDIR}/"
BBFILE_PRIORITY_useraccess = "6"

LAYERSERIES_COMPAT_useraccess = "scarthgap"
```
